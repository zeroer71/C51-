/*
***********************************************************************************************************************************************
*
*		模块名称 ： 发光灯模块
*		文件名称 ： 方式3应用.c
*		版本		 ： v1.0
*		说明		 ： 定时器0的工作方式3,TL0计数器对应的8位定时器实现第一个发光灯以1s间隔闪烁，
*								用TH0计数器对应的8位定时器实现第二个发光灯间隔0.5s闪烁
*								方式3只适用于定时器/计数器T0，方式3将T0分成两个独立的8位计数器TH0/TL0
*		修改记录 ：
*			  版本号	日期				作者			说明
*				v1.0		2020-01-19	Yang			v1.0版本进行测试
*			
*
***********************************************************************************************************************************************
*/

#include <reg52.h>
#define uchar unsigned char
#define uint unsigned int

sbit led1=P1^0;
sbit led2=P1^1;
uint count1,count2;

void main()
{
	TMOD=0x03;//定时器0，工作方式3
	TH0=6;//装初值
	TL0=6;
	EA=1;
	ET0=1;
	ET1=1;
	TR0=1;
	TR1=1;
	
	while(1)
	{
		if(count1>=3686)
		{
			count1=0;
			led1=~led1;
		}
		 if(count2>=1843)
		 {
			count2=0;
			 led2=~led2;
		 }
	}
}

/*定时器0中断服务函数*/
void TL0_time() interrupt 1
{
	TL0=6;
	count1++;
}

void TH0_time() interrupt 3
{
	TH0=6;
	count2++;
}